## meta-hidav/conf/layer.conf
```bitbake
# We have a conf and classes directory, add to BBPATH
BBPATH := ":${LAYERDIR}"

# We have a packages directory, add to BBFILES
BBFILES := "${LAYERDIR}/recipes*/*/*.bb ${LAYERDIR}/recipes*/*/*.bbappend"

BBFILE_COLLECTIONS += "hidav"
BBFILE_PATTERN_hidav := "^${LAYERDIR}/"
BBFILE_PRIORITY_hidav = "15"
```

## meta-hidav/conf/machine/hidav.conf
```bitbake
SOC_FAMILY = "ti814x"

require conf/machine/include/ti814x.inc

#  some overrides to the include above

UBOOT_MAKE_TARGET = "u-boot.ti"
IMAGE_FSTYPES = "tar.bz2 squashfs ext4"

# TI kernels break with gcc-4.7 (default on Angstrom)
ANGSTROM_GCC_VERSION = "4.5"
```

## meta-hipos/conf/layer.conf
```bitbake
# We have a conf and classes directory, add to BBPATH
BBPATH .= ":${LAYERDIR}"

# We have a packages directory, add to BBFILES
BBFILES += "${LAYERDIR}/recipes*/*/*.bb ${LAYERDIR}/recipes*/*/*.bbappend ${LAYERDIR}/recipes*/*/*.inc"

BBFILE_COLLECTIONS += "hipos"
BBFILE_PATTERN_hipos := "^${LAYERDIR}/"
BBFILE_PRIORITY_hipos = "8"
```
